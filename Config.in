## Config.in
```kconfig
source "$BR2_EXTERNAL_systemcoreathome_PATH/package/raspi-utils/Config.in"
source "$BR2_EXTERNAL_systemcoreathome_PATH/package/openjdk-bin-aarch64/Config.in"
```

## configs/systemcoreathome_defconfig
```kconfig
BR2_aarch64=y
BR2_cortex_a76=y
BR2_ARM64_PAGE_SIZE_16K=y
BR2_PACKAGE_HOST_LINUX_HEADERS_CUSTOM_6_12=y
BR2_TOOLCHAIN_BUILDROOT_CXX=y
BR2_CCACHE=y
BR2_GLOBAL_PATCH_DIR="$(BR2_EXTERNAL_systemcoreathome_PATH)/board/systemcoreathome/patches"
BR2_DOWNLOAD_FORCE_CHECK_HASHES=y
BR2_TARGET_GENERIC_HOSTNAME="robot"
BR2_INIT_SYSTEMD=y
BR2_ROOTFS_DEVICE_TABLE="$(BR2_EXTERNAL_systemcoreathome_PATH)/board/systemcoreathome/permission-table"
BR2_TARGET_GENERIC_ROOT_PASSWD="systemcore"
BR2_SYSTEM_DHCP="eth0"
BR2_SYSTEM_DEFAULT_PATH="/bin:/sbin:/usr/bin:/usr/sbin"
BR2_ROOTFS_USERS_TABLES="$(BR2_EXTERNAL_systemcoreathome_PATH)/board/systemcoreathome/users"
BR2_ROOTFS_OVERLAY="$(BR2_EXTERNAL_systemcoreathome_PATH)/board/systemcoreathome/overlay"
BR2_ROOTFS_POST_BUILD_SCRIPT="board/raspberrypi5/post-build.sh $(BR2_EXTERNAL_systemcoreathome_PATH)/board/systemcoreathome/post-build.sh"
BR2_ROOTFS_POST_IMAGE_SCRIPT="$(BR2_EXTERNAL_systemcoreathome_PATH)/board/systemcoreathome/post-image.sh"
BR2_LINUX_KERNEL=y
BR2_LINUX_KERNEL_CUSTOM_TARBALL=y
BR2_LINUX_KERNEL_CUSTOM_TARBALL_LOCATION="$(call github,rzblue,raspberrypi-linux,9fb33ff9c2e7f96f2bac6185b7fcc2b44f494a9c)/linux-9fb33ff9c2e7f96f2bac6185b7fcc2b44f494a9c.tar.gz"
BR2_LINUX_KERNEL_DEFCONFIG="systemcoreathome_rt"
BR2_LINUX_KERNEL_DTS_SUPPORT=y
BR2_LINUX_KERNEL_INTREE_DTS_NAME="broadcom/bcm2712-rpi-5-b broadcom/bcm2712d0-rpi-5-b broadcom/bcm2712-rpi-500"
BR2_LINUX_KERNEL_INTREE_DTSO_NAMES="overlays/spi1-3cs overlays/mcp251xfd overlays/disable-bt-pi5"
BR2_LINUX_KERNEL_DTB_OVERLAY_SUPPORT=y
BR2_LINUX_KERNEL_NEEDS_HOST_OPENSSL=y
# BR2_PACKAGE_BUSYBOX is not set
BR2_PACKAGE_XZ=y
BR2_PACKAGE_RT_TESTS=y
BR2_PACKAGE_STRACE=y
BR2_PACKAGE_STRESS=y
BR2_PACKAGE_STRESS_NG=y
BR2_PACKAGE_GREP=y
BR2_PACKAGE_SED=y
BR2_PACKAGE_E2FSPROGS=y
BR2_PACKAGE_E2FSPROGS_RESIZE2FS=y
BR2_PACKAGE_XORG7=y
BR2_PACKAGE_BRCMFMAC_SDIO_FIRMWARE_RPI=y
BR2_PACKAGE_BRCMFMAC_SDIO_FIRMWARE_RPI_WIFI=y
BR2_PACKAGE_LINUX_FIRMWARE=y
BR2_PACKAGE_LINUX_FIRMWARE_RTL_815X=y
BR2_PACKAGE_RPI_FIRMWARE=y
BR2_PACKAGE_RPI_FIRMWARE_CONFIG_FILE="$(BR2_EXTERNAL_systemcoreathome_PATH)/board/systemcoreathome/config.txt"
BR2_PACKAGE_RPI_FIRMWARE_CMDLINE_FILE="$(BR2_EXTERNAL_systemcoreathome_PATH)/board/systemcoreathome/cmdline.txt"
# BR2_PACKAGE_RPI_FIRMWARE_INSTALL_DTB_OVERLAYS is not set
BR2_PACKAGE_PARTED=y
BR2_PACKAGE_OPENJDK=y
BR2_PACKAGE_OPENJDK_JVM_VARIANT_CLIENT=y
BR2_PACKAGE_PYTHON3=y
BR2_PACKAGE_LIBCAP_TOOLS=y
BR2_PACKAGE_NCURSES_TARGET_PROGS=y
BR2_PACKAGE_CAN_UTILS=y
BR2_PACKAGE_ETHTOOL=y
BR2_PACKAGE_IPROUTE2=y
BR2_PACKAGE_IPUTILS=y
BR2_PACKAGE_NET_TOOLS=y
BR2_PACKAGE_OPENSSH=y
BR2_PACKAGE_PURE_FTPD=y
BR2_PACKAGE_RSYNC=y
BR2_PACKAGE_WGET=y
BR2_PACKAGE_OPKG=y
BR2_PACKAGE_DIALOG=y
BR2_PACKAGE_FILE=y
BR2_PACKAGE_SUDO=y
BR2_PACKAGE_COREUTILS=y
BR2_PACKAGE_HTOP=y
BR2_PACKAGE_PROCPS_NG=y
BR2_PACKAGE_TAR=y
BR2_PACKAGE_UTIL_LINUX_BINARIES=y
BR2_PACKAGE_UTIL_LINUX_IRQTOP=y
BR2_PACKAGE_UTIL_LINUX_KILL=y
BR2_PACKAGE_UTIL_LINUX_LOGIN=y
BR2_PACKAGE_UTIL_LINUX_SCHEDUTILS=y
BR2_PACKAGE_LESS=y
BR2_PACKAGE_NANO=y
BR2_PACKAGE_VIM=y
BR2_TARGET_ROOTFS_EXT2=y
BR2_TARGET_ROOTFS_EXT2_4=y
BR2_TARGET_ROOTFS_EXT2_SIZE="350M"
BR2_PACKAGE_HOST_DOSFSTOOLS=y
BR2_PACKAGE_HOST_GENIMAGE=y
BR2_PACKAGE_HOST_KMOD_XZ=y
BR2_PACKAGE_HOST_MTOOLS=y
BR2_PACKAGE_RASPI_UTILS=y
```

## package/openjdk-bin-aarch64/Config.in
```kconfig
config BR2_PACKAGE_OPENJDK_BIN_AARCH64
	bool "openjdk-bin-aarch64"
	depends on BR2_aarch64
	depends on BR2_TOOLCHAIN_HAS_THREADS
	help
	  Prebuilt OpenJDK JRE for aarch64 Linux
```

## package/rpi-utils/Config.in
```kconfig
config BR2_PACKAGE_RPI_UTILS
	bool "rpi-utils"
	depends on BR2_arm || BR2_aarch64
  depends on BR2_LINUX_KERNEL_DTS_SUPPORT
	depends on BR2_TOOLCHAIN_HAS_THREADS
	select BR2_PACKAGE_BASH # runtime
  select BR2_PACKAGE_DTC
  help
    A collection of scripts and simple applications for
    Raspberry Pi

    https://github.com/raspberrypi/utils
```
